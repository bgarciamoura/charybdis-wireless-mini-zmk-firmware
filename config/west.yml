## config/west.yml
```yaml
manifest:
  remotes:
    - name: zmkfirmware
      url-base: https://github.com/zmkfirmware
    - name: 280Zo
      url-base: https://github.com/280Zo
    - name: mfulz
      url-base: https://github.com/mfulz

  projects:
    - name: zmk
      remote: zmkfirmware
      revision: main
      import: app/west.yml
    - name: zmk-driver-pmw3360
      remote: mfulz
      revision: main
    - name: prospector-zmk-module
      remote: 280Zo
      revision: main

  self:
    path: config
```
